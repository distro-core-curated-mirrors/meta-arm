## meta-arm-gcs/conf/layer.conf
```bitbake
# We have a conf and classes directory, add to BBPATH
BBPATH .= ":${LAYERDIR}"

# We have recipes-* directories, add to BBFILES
BBFILES += "${LAYERDIR}/recipes-*/*/*.bb \
            ${LAYERDIR}/recipes-*/*/*.bbappend"

BBFILE_COLLECTIONS += "meta-arm-gcs"
BBFILE_PATTERN_meta-arm-gcs = "^${LAYERDIR}/"
BBFILE_PRIORITY_meta-arm-gcs = "5"

LAYERDEPENDS_meta-arm-gcs = "core meta-arm-bsp"
LAYERSERIES_COMPAT_meta-arm-gcs = "scarthgap"
```
